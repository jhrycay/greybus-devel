/*
 * Copyright (c) 2014-2015, The Linux Foundation. All rights reserved.
 * Copyright (c) 2016, Jason Hrycay. All rights reserved.
 *
 * This program is free software; you can redistribute it and/or modify
 * it under the terms of the GNU General Public License version 2 and
 * only version 2 as published by the Free Software Foundation.
 *
 * This program is distributed in the hope that it will be useful,
 * but WITHOUT ANY WARRANTY; without even the implied warranty of
 * MERCHANTABILITY or FITNESS FOR A PARTICULAR PURPOSE.  See the
 * GNU General Public License for more details.
 */

/dts-v1/;

#include "msm8996-mtp.dtsi"
#include "msm8996-moto-z.dtsi"

/ {
	qcom,msm-id = <246 0x30001>;
	qcom,board-id = <0x44 0x83A0>;
	qcom,pmic-id = <0x20009 0x2000A 0x0 0x0>;
	model = "Sheridan";
	compatible = "qcom,msm8996-griffin", "qcom,msm8996-moto",
			"qcom,msm8996";
};
